#include <STC12C5A60S2.H>  
#include <stdio.h>
#include <absacc.h>
#include <intrins.h>
#include <string.h>

#define  Fosc  11059200 //晶振频率

#define uchar unsigned char
#define uint unsigned int
//---------------------------液晶屏接线说明-------------------------------------//
//接线前请参考液晶屏说明书第10页引脚定义
sbit bl        =P3^2;//接模块BL引脚，背光可以采用IO控制或者PWM控制，也可以直接接到高电平常亮
sbit scl       =P1^7;//接模块CLK引脚,接裸屏Pin9_SCL
sbit sda       =P1^5;//接模块DIN/MOSI引脚，接裸屏Pin8_SDA
sbit rs        =P1^2;//接模块D/C引脚，接裸屏Pin7_A0
sbit cs        =P1^3;//接模块CE引脚，接裸屏Pin12_CS
sbit reset     =P3^3;//接模块RST引脚，接裸屏Pin6_RES
//---------------------------End of液晶屏接线---------------------------------//

//定义常用颜色
#define RED  		0xf800
#define GREEN		0x07e0
#define BLUE 		0x001f
#define WHITE		0xffff
#define BLACK		0x0000
#define YELLOW  0xFFE0
#define GRAY0   0xEF7D   
#define GRAY1   0x8410      	
#define GRAY2   0x4208   

void  Contrast_Adjust();
uchar code Zk_ASCII8X16[];

void Display_Desc();
void Output_Pixel(uint x,uint y);
void Display_ASCII8X16(uint x0,uint y0,uchar *s);

sbit  DATA=P3^4;	//手柄接口
sbit  CMND=P3^5;
sbit  ATT=P3^6;
sbit  CLK=P3^7;

uint code color_array[9]={RED,BLUE,YELLOW,WHITE,BLACK,GREEN,GRAY0,GRAY1,GRAY2};
int a=1;
int pos_x=10;
int pos_y=10;
uchar color_name;
uint one=0;
int color_pos=4;
uint line_color;
uint line_width_now=1;
uint line_width_old=1;
uchar line_width_char;
int line_length=5;
/*********手柄定义变量********/
uchar code scan[9]={0x01,0x42,0x00,0x00,0x00,0x00,0x00,0x00,0x00};
uchar  out[9];  
void color_name_fn(){
	if(line_color==0xf800)Display_ASCII8X16(10,115,"red");
	if(line_color==0x07e0)Display_ASCII8X16(10,115,"green");
	if(line_color==0x001f)Display_ASCII8X16(10,115,"blue");
	if(line_color==0xffff)Display_ASCII8X16(10,115,"white");
	if(line_color==0x0000)Display_ASCII8X16(10,115,"balck");
	if(line_color==0xffe0)Display_ASCII8X16(10,115,"yellow");
	if(line_color==0xef7d)Display_ASCII8X16(10,115,"gray0");
	if(line_color==0x8410)Display_ASCII8X16(10,115,"gray1");
	if(line_color==0x4208)Display_ASCII8X16(10,115,"gray2");
}
void delay_ms(uint time){
 uint i,j;
  for(i=0;i<time;i++)
   for(j=0;j<109;j++);
}

//向SPI总线传输一个8位数据
void  SPI_WriteData(uchar Data){
	unsigned char i=0;
	for(i=8;i>0;i--)
	{
		if(Data&0x80)	
		sda=1; //输出数据
		else sda=0;
		scl=0;
		scl=1;
		Data<<=1;
	}
}
//向液晶屏写一个8位指令
void  Lcd_WriteIndex(uchar Data){
		
		cs=0;
		rs=0;
		SPI_WriteData(Data); 		
		cs=1;
}
//向液晶屏写一个8位数据
void  Lcd_WriteData(uchar Data){	
		unsigned char i=0;
		cs=0;
		rs=1;
		SPI_WriteData(Data); 	
		cs=1;
}
//向液晶屏写一个16位数据
void  LCD_WriteData_16Bit(unsigned int Data){
	unsigned char i=0;
	cs=0;
	rs=1;
	SPI_WriteData(Data>>8); 	//写入高8位数据
	SPI_WriteData(Data); 			//写入低8位数据
	cs=1;

}

void Reset(){
    reset=0;
    delay_ms(100);
    reset=1;
    delay_ms(100);
}
//////////////////////////////////////////////////////////////////////////////////////////////
//液晶屏初始化 for S6D02A1
void lcd_initial()
{	Reset();//Reset before LCD Init.
		
	//LCD Init For 1.44Inch LCD Panel with ST7735R.
	Lcd_WriteIndex(0x11);//Sleep exit 
	delay_ms (120);
		
	//ST7735R Frame Rate
	Lcd_WriteIndex(0xB1); 
	Lcd_WriteData(0x01); 
	Lcd_WriteData(0x2C); 
	Lcd_WriteData(0x2D); 

	Lcd_WriteIndex(0xB2); 
	Lcd_WriteData(0x01); 
	Lcd_WriteData(0x2C); 
	Lcd_WriteData(0x2D); 

	Lcd_WriteIndex(0xB3); 
	Lcd_WriteData(0x01); 
	Lcd_WriteData(0x2C); 
	Lcd_WriteData(0x2D); 
	Lcd_WriteData(0x01); 
	Lcd_WriteData(0x2C); 
	Lcd_WriteData(0x2D); 
	
	Lcd_WriteIndex(0xB4); //Column inversion 
	Lcd_WriteData(0x07); 
	
	//ST7735R Power Sequence
	Lcd_WriteIndex(0xC0); 
	Lcd_WriteData(0xA2); 
	Lcd_WriteData(0x02); 
	Lcd_WriteData(0x84); 
	Lcd_WriteIndex(0xC1); 
	Lcd_WriteData(0xC5); 

	Lcd_WriteIndex(0xC2); 
	Lcd_WriteData(0x0A); 
	Lcd_WriteData(0x00); 

	Lcd_WriteIndex(0xC3); 
	Lcd_WriteData(0x8A); 
	Lcd_WriteData(0x2A); 
	Lcd_WriteIndex(0xC4); 
	Lcd_WriteData(0x8A); 
	Lcd_WriteData(0xEE); 
	
	Lcd_WriteIndex(0xC5); //VCOM 
	Lcd_WriteData(0x0E); 
	
	Lcd_WriteIndex(0x36); //MX, MY, RGB mode 
#ifdef USE_LANDSCAPE
	Lcd_WriteData(0xA8); //竖屏C8 横屏08 A8
#else
	Lcd_WriteData(0xC8); //竖屏C8 横屏08 A8
#endif		
	//ST7735R Gamma Sequence
	Lcd_WriteIndex(0xe0); 
	Lcd_WriteData(0x0f); 
	Lcd_WriteData(0x1a); 
	Lcd_WriteData(0x0f); 
	Lcd_WriteData(0x18); 
	Lcd_WriteData(0x2f); 
	Lcd_WriteData(0x28); 
	Lcd_WriteData(0x20); 
	Lcd_WriteData(0x22); 
	Lcd_WriteData(0x1f); 
	Lcd_WriteData(0x1b); 
	Lcd_WriteData(0x23); 
	Lcd_WriteData(0x37); 
	Lcd_WriteData(0x00); 	
	Lcd_WriteData(0x07); 
	Lcd_WriteData(0x02); 
	Lcd_WriteData(0x10); 

	Lcd_WriteIndex(0xe1); 
	Lcd_WriteData(0x0f); 
	Lcd_WriteData(0x1b); 
	Lcd_WriteData(0x0f); 
	Lcd_WriteData(0x17); 
	Lcd_WriteData(0x33); 
	Lcd_WriteData(0x2c); 
	Lcd_WriteData(0x29); 
	Lcd_WriteData(0x2e); 
	Lcd_WriteData(0x30); 
	Lcd_WriteData(0x30); 
	Lcd_WriteData(0x39); 
	Lcd_WriteData(0x3f); 
	Lcd_WriteData(0x00); 
	Lcd_WriteData(0x07); 
	Lcd_WriteData(0x03); 
	Lcd_WriteData(0x10);  
	
	Lcd_WriteIndex(0x2a);
	Lcd_WriteData(0x00);
	Lcd_WriteData(0x00+2);
	Lcd_WriteData(0x00);
	Lcd_WriteData(0x80+2);

	Lcd_WriteIndex(0x2b);
	Lcd_WriteData(0x00);
	Lcd_WriteData(0x00+3);
	Lcd_WriteData(0x00);
	Lcd_WriteData(0x80+3);
	
	Lcd_WriteIndex(0xF0); //Enable test command  
	Lcd_WriteData(0x01); 
	Lcd_WriteIndex(0xF6); //Disable ram power save mode 
	Lcd_WriteData(0x00); 
	
	Lcd_WriteIndex(0x3A); //65k mode 
	Lcd_WriteData(0x05); 
	
	
	Lcd_WriteIndex(0x29);//Display on

}



/*************************************************
函数名：LCD_Set_Region
功能：设置lcd显示区域，在此区域写点数据自动换行
入口参数：xy起点和终点
返回值：无
*************************************************/
void Lcd_SetRegion(unsigned int x_start,unsigned int y_start,unsigned int x_end,unsigned int y_end){	
#ifdef USE_LANDSCAPE//使用横屏模式
	Lcd_WriteIndex(0x2a);
	Lcd_WriteData(0x00);
	Lcd_WriteData(x_start+3);
	Lcd_WriteData(0x00);
	Lcd_WriteData(x_end+3);

	Lcd_WriteIndex(0x2b);
	Lcd_WriteData(0x00);
	Lcd_WriteData(y_start+2);
	Lcd_WriteData(0x00);
	Lcd_WriteData(y_end+2);

#else//竖屏模式	
	Lcd_WriteIndex(0x2a);
	Lcd_WriteData(0x00);
	Lcd_WriteData(x_start+2);
	Lcd_WriteData(0x00);
	Lcd_WriteData(x_end+2);

	Lcd_WriteIndex(0x2b);
	Lcd_WriteData(0x00);
	Lcd_WriteData(y_start+3);
	Lcd_WriteData(0x00);
	Lcd_WriteData(y_end+3);	
#endif
	Lcd_WriteIndex(0x2c);
}
void out_oled(){
	if(pos_x<=0)pos_x=0;
	if(pos_x>=128)pos_x=128;
	if(pos_y<=0)pos_y=0;
	if(pos_y>=128)pos_y=128;
}

void PutPixel(uint x_start,uint y_start,uint color){//聚焦一个点并且绘制颜色
	Lcd_SetRegion(x_start,y_start,x_start+1,y_start+1);
	LCD_WriteData_16Bit(color);
}

void dsp_single_colour(int color){//绘制整个屏幕颜色  要几秒时间
 	uchar i,j;
	Lcd_SetRegion(0,0,128-1,128-1);
 	for (i=0;i<128;i++)
    	for (j=0;j<128;j++)
        	LCD_WriteData_16Bit(color);
}
void line_up(int line_l,uint line_width,uint color){//聚焦点向上移动line_l 
	int yy;
	uint line_long=line_l;
	uint line_w=line_width;
	for(;line_width>0;line_width--){
		yy=pos_y;
		pos_x+=1;
		line_l=line_long;
		for(;line_l>0;line_l--){
			yy-=1;
			out_oled();
			PutPixel(pos_x-1,yy+line_width_old+1,color);
	  }
	}
	pos_x-=line_w;
	pos_y-=line_long;
	line_width_old=line_w;
}
void line_down(int line_l,uint line_width,uint color){
	int yy;
	uint line_long=line_l;
	uint line_w=line_width;
	for(;line_width>0;line_width--){
		yy=pos_y;
		pos_x+=1;
		line_l=line_long;
		for(;line_l>0;line_l--){
			yy+=1;
			out_oled();
			PutPixel(pos_x-1,yy,color);
		}
	}
	pos_x-=line_w;
	pos_y+=line_long;
	line_width_old=line_w;
}
void line_left(int line_l,uint line_width,uint color){
	int xx;
	uint line_long=line_l;
	uint line_w=line_width;
	for(;line_width>0;line_width--){
		xx=pos_x;
		pos_y+=1;
		line_l=line_long;
		for(;line_l>0;line_l--){
			xx-=1;
			out_oled();
			PutPixel(xx+line_width_old,pos_y,color);
		}
	}
	pos_y-=line_w;
	pos_x-=line_long;
	line_width_old=line_w;
}
void line_right(int line_l,uint line_width , uint color){
	int xx;
	uint line_long=line_l;
	uint line_w=line_width;
	for(;line_width>0;line_width--){
		xx=pos_x;
		pos_y+=1;
		line_l=line_long;
		for(;line_l>0;line_l--){
			xx+=1;
			out_oled();
			PutPixel(xx-1,pos_y,color);
		}
	}
	pos_y-=line_w;
	pos_x+=line_long;
	line_width_old=line_w;
}
void cls(int x_cls,int y_cls,uint line_x,uint line_y){//清理区域屏幕
	uchar i,j;
	Lcd_SetRegion(x_cls,y_cls,x_cls+line_x-1,y_cls+line_y-1);
 	for (i=x_cls;i<x_cls+line_x;i++)
    	for (j=y_cls;j<y_cls+line_y;j++)
        	LCD_WriteData_16Bit(WHITE);
}
//显示一个英文字符
void width_fn(uint tar){
	if(tar==1)Display_ASCII8X16(10,115,"width 1");
	if(tar==2)Display_ASCII8X16(10,115,"width 2");
	if(tar==3)Display_ASCII8X16(10,115,"width 3");
	if(tar==4)Display_ASCII8X16(10,115,"width 4");
	if(tar==5)Display_ASCII8X16(10,115,"width 5");
}
void length_fn(uint tar){
	if(tar==2)Display_ASCII8X16(10,115,"length 2");
	if(tar==5)Display_ASCII8X16(10,115,"length 5");
	if(tar==8)Display_ASCII8X16(10,115,"length 8");
}
void Display_ASCII8X16(uint x0,uint y0,uchar *s){
	int i,j,k,x,y,xx;
	
	unsigned char qm;
	
	long int ulOffset;
	
	char  ywbuf[32],temp[2];

	for(i = 0; i<strlen((char*)s);i++)
	{
		if(((unsigned char)(*(s+i))) >= 161)
		{
			temp[0] = *(s+i);
			temp[1] = '\0';
			return;
		}
		
		else
		{
			qm = *(s+i);

			ulOffset = (long int)(qm) * 16;
			
      for (j = 0; j < 16; j ++)
      {
				ywbuf[j]=Zk_ASCII8X16[ulOffset+j];
      }
             
      for(y = 0;y < 16;y++)
      {
	        for(x=0;x<8;x++) 
	        {
             k=x % 8;
                	
				  	if(ywbuf[y]&(0x80 >> k))
				   	{
				  		xx=x0+x+i*8;
				    	PutPixel(xx,y+y0,RED);
				  	}
							
			   	}
      }

		}
	}     	
}

void delayms(uint xms){
   uint i,j;
   for(i=xms;i>0;i--)
      for(j=109;j>0;j--);
 }

void uart_init(unsigned int baud){//串口波特率
	SCON=0x50;
	TMOD&=0x0F;
	TMOD|=0x20;
	TH1=256-(11059200/12/32)/baud;
	TL1=TH1;
	ET1=0;
	TR1=1;
}

void uart_sendata(uchar n){//串口接收	
	 SBUF = n;
	 while(!TI);
	 TI=0;			
}

void delay_us(uint n){
	uint i;
	for(i=0;i<n;i++) _nop_();
}
void psin(uchar command){
    uchar i;
    for(i=0;i<=7;i++){
	 if(command&0x01)
        CMND=1;
     else
        CMND=0;
     command=command>>1;
	 	_nop_();	
		_nop_();
     CLK=0;
     delay_us(10); 
     CLK=1;
	 delay_us(3);
    }
	CMND=1;
}
uchar scanout(uchar command){
    uchar i,j=1;
	uchar res=0; 
    for(i=0;i<=7;i++){
	 if(command&0x01)
        CMND=1;
     else
        CMND=0;
     command=command>>1;
	 	_nop_();	
		_nop_();
     CLK=0;
     delay_us(10);
	 if(DATA) res=res+j;
     j=j<<1; 
	 CLK=1;
	 delay_us(3);		 
    }
    CMND=1;
    return res;	
}
 void Read_PS2(void)//手柄读取程序
{
	 uchar i;
     ATT=0;
	 for(i=0;i<9;i++)	//扫描按键
        {
         out[i]=scanout(scan[i]);	
		 } 
     ATT=1;	    	 
   	 //for(i=0;i<9;i++){
			// uart_sendata(0x30);
			 //uart_sendata(0x78);
			 //if(out[i]/16<10) uart_sendata(out[i]/16+0x30);
			// else uart_sendata(out[i]/16+0x37);
			// if(out[i]%16<10) uart_sendata(out[i]%16+0x30);
			// else uart_sendata(out[i]%16+0x37);
			// uart_sendata(' ');
	 	// }
	//uart_sendata(0x0d);
  //uart_sendata(0x0a);		  
} 	 	

void main(){ 
	#ifdef MCU_STC12
	P3M1 &= ~(1<<2),	P3M0 |=  (1<<2);	//P3.2 set as push-pull output mode
  #endif
	lcd_initial();
	bl=1;
	delayms(500);
	uart_init(9600);
	dsp_single_colour(WHITE);//白色
	line_color=color_array[color_pos];
	color_name_fn();
	delay_ms(200);//200ms显示的时间
  cls(10,115,50,13);//清理小区域屏幕
	width_fn(line_width_now);
	cls(5,115,65,13);
	length_fn(line_length);
	cls(5,115,70,13);
  while(1){
		Read_PS2(); 
		if(out[3]==0xEF){//左边上键
			line_up(line_length,line_width_now,line_color);
		}
		if(out[3]==0xBF){//左边下键
			line_down(line_length,line_width_now,line_color);
		}
		if(out[3]==0x7F){//左边左键
			out_oled();
			line_left(line_length,line_width_now,line_color);
		}
		if(out[3]==0xDF){//左边右键
			out_oled();
			line_right(line_length,line_width_now,line_color);
		}
		if(out[4]==0xEF && one==0){//右边上键  换颜色
		 one=1;
		 color_pos+=1;
		 if(color_pos>=8)color_pos=8;
		 line_color=color_array[color_pos];
		 color_name_fn();
		 delay_ms(200);
		 cls(10,115,50,13);
		}
		if(out[4]==0xBF && one==0){//右边下键  换颜色
			one=1;
			color_pos-=1;
			if(color_pos<=0)color_pos=0;
			line_color=color_array[color_pos];
			color_name_fn();
			delay_ms(200);
			cls(10,115,50,13);
		}
		if(out[4]==0xDF && one==0){//清屏
			one=1;
			Display_ASCII8X16(10,115,"clear screen");
			dsp_single_colour(WHITE);//白色
		}
		if(out[4]==0xF7 && one==0){//R1键  线宽度+1
			one=1;
			line_width_now+=1;
			if(line_width_now>=5)line_width_now=5;
			width_fn(line_width_now);
			cls(5,115,65,13);
		}
		if(out[4]==0xFD && one==0){//R2键   线宽度-1
			one=1;
			line_width_now-=1;
			if(line_width_now<=1)line_width_now=1;
			width_fn(line_width_now);
			cls(5,115,65,13);
		}
		if(out[4]==0xFB && one==0){
			one=1;
			line_length+=3;
			if(line_length>=8)line_length=8;
			length_fn(line_length);
			cls(5,115,70,13);
		}
		if(out[4]==0xFE && one==0){
			one=1;
			line_length-=3;
			if(line_length<=2)line_length=2;
			length_fn(line_length);
			cls(5,115,70,13);
		}
		if(out[4]==0xFF)one=0;
		 delayms(70);
	}
} 

/*****************************PS2遥控器说明
out[3]==0xEF//左4个按键中上
out[3]==0xBF//左4个按键中下
out[3]==0x7F//左4个按键中左
out[3]==0xDF//左4个按键中右

out[4]==0xEF//右4个按键中上
out[4]==0xBF//右4个按键中下
out[4]==0x7F//右4个按键中左
out[4]==0xDF//右4个按键中右

out[4]==0xFB//左1,2个按键中1
out[4]==0xFE//左1,2个按键中2
out[4]==0xF7//右1,2个按键中1
out[4]==0xFD//右1,2个按键中2

当按下MODE键手柄MODE LED灯亮起时
out[7] 00——80——FF 左摇杆从左到右
out[8] 00——7F——FF 左摇杆从上到下
out[5] 00——80——FF 右摇杆从左到右
out[6] 00——7F——FF 右摇杆从上到下
当手柄MODE LED灯不亮时，手柄功能同左四右四按键
*******************************/
uchar code Zk_ASCII8X16[]=
 {
  0x00,0x00,0x00,0x00,0x00,0x00,0x00,0x00,0x00,0x00,0x00,0x00,0x00,
  0x00,0x00,0x00,0x00,0x00,0x00,0x00,0x00,0x00,0x00,0x00,0x00,0x00,
  0x00,0x00,0x00,0x00,0x00,0x00,0x00,0x00,0x00,0x00,0x00,0x00,0x00,
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  0x00,0x00 
  };
